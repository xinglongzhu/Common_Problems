## distance_test/Kconfig
```kconfig
source "Kconfig.zephyr"

config INCLUDE_USER_NET_CORE_IMAGE
	bool "Include net image as sub image"
	depends on SOC_NRF5340_CPUAPP
	default y if (BOARD_NRF5340DK_NRF5340_CPUAPP || BOARD_NRF5340DK_NRF5340_CPUAPPNS)
	select PARTITION_MANAGER_ENABLED
	select BOARD_ENABLE_CPUNET
```
