/ {
	nrf_radio_fem: nrf21540_fem {
		compatible = "nordic,nrf21540-fem";
		tx-en-gpios = <&gpio1 8 GPIO_ACTIVE_HIGH>;   /* D5 */
		rx-en-gpios = <&gpio0 23 GPIO_ACTIVE_HIGH>;    /* D3 */
		pdn-gpios = <&gpio1 4 GPIO_ACTIVE_HIGH>;     /* D9 */
		ant-sel-gpios = <&gpio1 7 GPIO_ACTIVE_HIGH>; /* D4 */
		mode-gpios = <&gpio0 27 GPIO_ACTIVE_HIGH>;     /* D2 */
		supply-voltage-mv = <3000>;
	};
};

&radio {
	fem = <&nrf_radio_fem>;
};

